AUTOSAR XML (schema 4-3-0)
package /pe_pmsm_drive_project_pkg/pe_pmsm_drive_project_imp
  swc implementation pe_pmsm_drive_project: programming-language=C, sw-version=1.142.1, used-code-generator=Embedded Coder 7.1 (R2018b) 24-May-2018, vendor-id=0, behavior=pe_pmsm_drive_project
    code-descriptors:
      code Code
        artifact-descriptors:
          short-label=ex_04d5441d_c, category=SWSRC
          short-label=ex_136645f8_c, category=SWSRC
          short-label=ex_17bc61ac_c, category=SWSRC
          short-label=ex_18b4440a_c, category=SWSRC
          short-label=ex_2ebcd5b2_c, category=SWSRC
          short-label=ex_316a81de_c, category=SWSRC
          short-label=ex_40d5be33_c, category=SWSRC
          short-label=ex_47b11894_c, category=SWSRC
          short-label=ex_690b7cd0_c, category=SWSRC
          short-label=ex_79d100f1_c, category=SWSRC
          short-label=ex_8a6fc761_c, category=SWSRC
          short-label=ex_b2b40ad5_c, category=SWSRC
          short-label=ex_bb0efd4b_c, category=SWSRC
          short-label=ex_debffef2_c, category=SWSRC
          short-label=ex_e40d74b8_c, category=SWSRC
          short-label=ex_f866102d_c, category=SWSRC
          short-label=mc_026e4f4b_c, category=SWSRC
          short-label=mc_03b98f6f_c, category=SWSRC
          short-label=mc_0bd30dee_c, category=SWSRC
          short-label=mc_0d6fd085_c, category=SWSRC
          short-label=mc_0ed73c49_c, category=SWSRC
          short-label=mc_11086079_c, category=SWSRC
          short-label=mc_110e6c6c_c, category=SWSRC
          short-label=mc_15d12d95_c, category=SWSRC
          short-label=mc_15d828ca_c, category=SWSRC
          short-label=mc_220ba961_c, category=SWSRC
          short-label=mc_2565d6e0_c, category=SWSRC
          short-label=mc_2a642f54_c, category=SWSRC
          short-label=mc_2a6a9b24_c, category=SWSRC
          short-label=mc_2bbf87e3_c, category=SWSRC
          short-label=mc_2cdc96b4_c, category=SWSRC
          short-label=mc_32d501e3_c, category=SWSRC
          short-label=mc_32dc008a_c, category=SWSRC
          short-label=mc_3b6a945d_c, category=SWSRC
          short-label=mc_3e66abdf_c, category=SWSRC
          short-label=mc_4105189f_c, category=SWSRC
          short-label=mc_47b8cebe_c, category=SWSRC
          short-label=mc_47b91db1_c, category=SWSRC
          short-label=mc_4b0301c6_c, category=SWSRC
          short-label=mc_4c6117e3_c, category=SWSRC
          short-label=mc_51d4094e_c, category=SWSRC
          short-label=mc_52623861_c, category=SWSRC
          short-label=mc_52688a58_c, category=SWSRC
          short-label=mc_53b1fc84_c, category=SWSRC
          short-label=mc_550847c3_c, category=SWSRC
          short-label=mc_5766048f_c, category=SWSRC
          short-label=mc_59b6e413_c, category=SWSRC
          short-label=mc_5d65cd86_c, category=SWSRC
          short-label=mc_630208f8_c, category=SWSRC
          short-label=mc_630dda0e_c, category=SWSRC
          short-label=mc_67da200d_c, category=SWSRC
          short-label=mc_67da4f41_c, category=SWSRC
          short-label=mc_6b6d311a_c, category=SWSRC
          short-label=mc_6e61d16c_c, category=SWSRC
          short-label=mc_6fb1c336_c, category=SWSRC
          short-label=mc_7a613aec_c, category=SWSRC
          short-label=mc_7bbf41f0_c, category=SWSRC
          short-label=mc_7cd58f0b_c, category=SWSRC
          short-label=mc_7cdbe436_c, category=SWSRC
          short-label=mc_7d0547c8_c, category=SWSRC
          short-label=mc_7d099de7_c, category=SWSRC
          short-label=mc_7eb21b39_c, category=SWSRC
          short-label=mc_81b0ada5_c, category=SWSRC
          short-label=mc_81b5717e_c, category=SWSRC
          short-label=mc_870ec75e_c, category=SWSRC
          short-label=mc_89d597cf_c, category=SWSRC
          short-label=mc_90b6aa0a_c, category=SWSRC
          short-label=mc_95b62b73_c, category=SWSRC
          short-label=mc_9ab7d9b0_c, category=SWSRC
          short-label=mc_9b6376d1_c, category=SWSRC
          short-label=mc_9b6c1529_c, category=SWSRC
          short-label=mc_a2647600_c, category=SWSRC
          short-label=mc_a26bab1a_c, category=SWSRC
          short-label=mc_a3b90582_c, category=SWSRC
          short-label=mc_a865d1dd_c, category=SWSRC
          short-label=mc_acb3fad7_c, category=SWSRC
          short-label=mc_af0cc4c9_c, category=SWSRC
          short-label=mc_b0de9cbc_c, category=SWSRC
          short-label=mc_b362c5eb_c, category=SWSRC
          short-label=mc_b7b03d44_c, category=SWSRC
          short-label=mc_b96a0bad_c, category=SWSRC
          short-label=mc_bb0520ee_c, category=SWSRC
          short-label=mc_bdbb9b78_c, category=SWSRC
          short-label=mc_c2dbf4b2_c, category=SWSRC
          short-label=mc_c8d25d23_c, category=SWSRC
          short-label=mc_cab8a1f9_c, category=SWSRC
          short-label=mc_d20085b7_c, category=SWSRC
          short-label=mc_d9d38185_c, category=SWSRC
          short-label=mc_dbbb14d2_c, category=SWSRC
          short-label=mc_dcdddfae_c, category=SWSRC
          short-label=mc_debb448f_c, category=SWSRC
          short-label=mc_e7bc2f1a_c, category=SWSRC
          short-label=mc_e969ae87_c, category=SWSRC
          short-label=mc_edbf543c_c, category=SWSRC
          short-label=mc_ee000fbe_c, category=SWSRC
          short-label=mc_efdea3a7_c, category=SWSRC
          short-label=mc_f3be157c_c, category=SWSRC
          short-label=mc_fcb15a9b_c, category=SWSRC
          short-label=mc_fd619d14_c, category=SWSRC
          short-label=mc_fd6341bb_c, category=SWSRC
          short-label=ne_59b4e14a_c, category=SWSRC
          short-label=pe_pmsm_drive_project_c, category=SWSRC
          short-label=pe_pmsm_drive_project_5df20146_1_c, category=SWSRC
          short-label=pe_pmsm_drive_project_5df20146_1_ds_c, category=SWSRC
          short-label=pe_pmsm_drive_project_5df20146_1_ds_a_p_c, category=SWSRC
          short-label=pe_pmsm_drive_project_5df20146_1_ds_dnf_p_c, category=SWSRC
          short-label=pe_pmsm_drive_project_5df20146_1_ds_dtf_c, category=SWSRC
          short-label=pe_pmsm_drive_project_5df20146_1_ds_dxf_c, category=SWSRC
          short-label=pe_pmsm_drive_project_5df20146_1_ds_dxf_p_c, category=SWSRC
          short-label=pe_pmsm_drive_project_5df20146_1_ds_dxy_p_c, category=SWSRC
          short-label=pe_pmsm_drive_project_5df20146_1_ds_f_c, category=SWSRC
          short-label=pe_pmsm_drive_project_5df20146_1_ds_log_c, category=SWSRC
          short-label=pe_pmsm_drive_project_5df20146_1_ds_mode_c, category=SWSRC
          short-label=pe_pmsm_drive_project_5df20146_1_ds_obs_act_c, category=SWSRC
          short-label=pe_pmsm_drive_project_5df20146_1_ds_obs_all_c, category=SWSRC
          short-label=pe_pmsm_drive_project_5df20146_1_ds_obs_exp_c, category=SWSRC
          short-label=pe_pmsm_drive_project_5df20146_1_ds_tdxf_p_c, category=SWSRC
          short-label=pe_pmsm_drive_project_5df20146_1_ds_tdxy_p_c, category=SWSRC
          short-label=pe_pmsm_drive_project_5df20146_1_ds_zc_c, category=SWSRC
          short-label=pe_pmsm_drive_project_5df20146_1_gateway_c, category=SWSRC
          short-label=pe_pmsm_drive_project_data_c, category=SWSRC
          short-label=pm_09bc42e2_c, category=SWSRC
          short-label=pm_14098e54_c, category=SWSRC
          short-label=pm_26dc3230_c, category=SWSRC
          short-label=pm_4fd5f5b9_c, category=SWSRC
          short-label=pm_fed8c2c9_c, category=SWSRC
          short-label=pm_printf_c, category=SWSRC
          short-label=rt_backsubrr_dbl_c, category=SWSRC
          short-label=rt_forwardsubrr_dbl_c, category=SWSRC
          short-label=rt_lu_real_c, category=SWSRC
          short-label=rt_matrixlib_dbl_c, category=SWSRC
          short-label=ssc_core_01dcc633_c, category=SWSRC
          short-label=ssc_core_04da2c69_c, category=SWSRC
          short-label=ssc_core_05058dd9_c, category=SWSRC
          short-label=ssc_core_06ba68a6_c, category=SWSRC
          short-label=ssc_core_09b5fa6e_c, category=SWSRC
          short-label=ssc_core_0bd666aa_c, category=SWSRC
          short-label=ssc_core_0f019bd9_c, category=SWSRC
          short-label=ssc_core_0f0420a6_c, category=SWSRC
          short-label=ssc_core_18bf4d77_c, category=SWSRC
          short-label=ssc_core_1b0cafd5_c, category=SWSRC
          short-label=ssc_core_1c6b0332_c, category=SWSRC
          short-label=ssc_core_1fd25120_c, category=SWSRC
          short-label=ssc_core_24b4cdee_c, category=SWSRC
          short-label=ssc_core_2568b075_c, category=SWSRC
          short-label=ssc_core_280c0222_c, category=SWSRC
          short-label=ssc_core_2cd54448_c, category=SWSRC
          short-label=ssc_core_3169e4b7_c, category=SWSRC
          short-label=ssc_core_360a4baf_c, category=SWSRC
          short-label=ssc_core_37d4ea84_c, category=SWSRC
          short-label=ssc_core_40dfdbdc_c, category=SWSRC
          short-label=ssc_core_41017299_c, category=SWSRC
          short-label=ssc_core_4666b45b_c, category=SWSRC
          short-label=ssc_core_48b08af1_c, category=SWSRC
          short-label=ssc_core_48b1386a_c, category=SWSRC
          short-label=ssc_core_4965213d_c, category=SWSRC
          short-label=ssc_core_4ad9135b_c, category=SWSRC
          short-label=ssc_core_4db6bd68_c, category=SWSRC
          short-label=ssc_core_4db86fcc_c, category=SWSRC
          short-label=ssc_core_4e03e39d_c, category=SWSRC
          short-label=ssc_core_4e04eecd_c, category=SWSRC
          short-label=ssc_core_54d55ae9_c, category=SWSRC
          short-label=ssc_core_5505224d_c, category=SWSRC
          short-label=ssc_core_56b1a2bf_c, category=SWSRC
          short-label=ssc_core_576cd129_c, category=SWSRC
          short-label=ssc_core_59b034b8_c, category=SWSRC
          short-label=ssc_core_5d6ba758_c, category=SWSRC
          short-label=ssc_core_67d1f118_c, category=SWSRC
          short-label=ssc_core_68da074b_c, category=SWSRC
          short-label=ssc_core_6b6b89d2_c, category=SWSRC
          short-label=ssc_core_6dd833f3_c, category=SWSRC
          short-label=ssc_core_73d9c2b7_c, category=SWSRC
          short-label=ssc_core_76d825be_c, category=SWSRC
          short-label=ssc_core_79dd08ab_c, category=SWSRC
          short-label=ssc_core_7a613edb_c, category=SWSRC
          short-label=ssc_core_83db8762_c, category=SWSRC
          short-label=ssc_core_856738f2_c, category=SWSRC
          short-label=ssc_core_8569edc5_c, category=SWSRC
          short-label=ssc_core_8a6471dc_c, category=SWSRC
          short-label=ssc_core_8d0064b8_c, category=SWSRC
          short-label=ssc_core_96061071_c, category=SWSRC
          short-label=ssc_core_97d767fe_c, category=SWSRC
          short-label=ssc_core_9b607b15_c, category=SWSRC
          short-label=ssc_core_9c016445_c, category=SWSRC
          short-label=ssc_core_9c01d168_c, category=SWSRC
          short-label=ssc_core_9dd110ad_c, category=SWSRC
          short-label=ssc_core_9fb0e229_c, category=SWSRC
          short-label=ssc_core_9fb25b4f_c, category=SWSRC
          short-label=ssc_core_a1d393be_c, category=SWSRC
          short-label=ssc_core_a4d4c45e_c, category=SWSRC
          short-label=ssc_core_a4da1d0a_c, category=SWSRC
          short-label=ssc_core_a6b78ccc_c, category=SWSRC
          short-label=ssc_core_a76299bc_c, category=SWSRC
          short-label=ssc_core_a867d880_c, category=SWSRC
          short-label=ssc_core_a9bf1ff2_c, category=SWSRC
          short-label=ssc_core_abd05c18_c, category=SWSRC
          short-label=ssc_core_abd5e7b4_c, category=SWSRC
          short-label=ssc_core_acb64294_c, category=SWSRC
          short-label=ssc_core_acb6462e_c, category=SWSRC
          short-label=ssc_core_b1038cbb_c, category=SWSRC
          short-label=ssc_core_b10e34f4_c, category=SWSRC
          short-label=ssc_core_b2b3b239_c, category=SWSRC
          short-label=ssc_core_b3671372_c, category=SWSRC
          short-label=ssc_core_b402b40d_c, category=SWSRC
          short-label=ssc_core_b7b88213_c, category=SWSRC
          short-label=ssc_core_b96ebc21_c, category=SWSRC
          short-label=ssc_core_bb0b2992_c, category=SWSRC
          short-label=ssc_core_bc648043_c, category=SWSRC
          short-label=ssc_core_c3003040_c, category=SWSRC
          short-label=ssc_core_c5b050d7_c, category=SWSRC
          short-label=ssc_core_c5b63cb2_c, category=SWSRC
          short-label=ssc_core_c607b660_c, category=SWSRC
          short-label=ssc_core_c8d83e88_c, category=SWSRC
          short-label=ssc_core_cab615c8_c, category=SWSRC
          short-label=ssc_core_cabdc251_c, category=SWSRC
          short-label=ssc_core_cc067f58_c, category=SWSRC
          short-label=ssc_core_ce6a84bb_c, category=SWSRC
          short-label=ssc_core_d06d763c_c, category=SWSRC
          short-label=ssc_core_d3d34d7c_c, category=SWSRC
          short-label=ssc_core_d70a6a09_c, category=SWSRC
          short-label=ssc_core_d807fa59_c, category=SWSRC
          short-label=ssc_core_d9d13dac_c, category=SWSRC
          short-label=ssc_core_dcda6edd_c, category=SWSRC
          short-label=ssc_core_deb7fd8d_c, category=SWSRC
          short-label=ssc_core_e0d0866d_c, category=SWSRC
          short-label=ssc_core_e2b61d72_c, category=SWSRC
          short-label=ssc_core_e400c1c2_c, category=SWSRC
          short-label=ssc_core_ee000fbe_c, category=SWSRC
          short-label=ssc_core_ee01086d_c, category=SWSRC
          short-label=ssc_core_ee0f0141_c, category=SWSRC
          short-label=ssc_core_f9b6dbed_c, category=SWSRC
          short-label=ssc_core_fa09e9e6_c, category=SWSRC
          short-label=ssc_core_fbd34e62_c, category=SWSRC
          short-label=ssc_core_ff06d9a4_c, category=SWSRC
          short-label=ssc_sli_0763c151_c, category=SWSRC
          short-label=ssc_sli_0bd269e6_c, category=SWSRC
          short-label=ssc_sli_136b443c_c, category=SWSRC
          short-label=ssc_sli_140b3534_c, category=SWSRC
          short-label=ssc_sli_15d5f6ce_c, category=SWSRC
          short-label=ssc_sli_2bbd58a4_c, category=SWSRC
          short-label=ssc_sli_360cfd63_c, category=SWSRC
          short-label=ssc_sli_43618287_c, category=SWSRC
          short-label=ssc_sli_466b08dd_c, category=SWSRC
          short-label=ssc_sli_496799bd_c, category=SWSRC
          short-label=ssc_sli_4e028390_c, category=SWSRC
          short-label=ssc_sli_51dbd3b5_c, category=SWSRC
          short-label=ssc_sli_550a4805_c, category=SWSRC
          short-label=ssc_sli_5a0cb974_c, category=SWSRC
          short-label=ssc_sli_5d63aeeb_c, category=SWSRC
          short-label=ssc_sli_62d81790_c, category=SWSRC
          short-label=ssc_sli_77063d8b_c, category=SWSRC
          short-label=ssc_sli_7a618260_c, category=SWSRC
          short-label=ssc_sli_880e593a_c, category=SWSRC
          short-label=ssc_sli_89d0f30a_c, category=SWSRC
          short-label=ssc_sli_8a64c4e2_c, category=SWSRC
          short-label=ssc_sli_93019ea6_c, category=SWSRC
          short-label=ssc_sli_9abcdb7f_c, category=SWSRC
          short-label=ssc_sli_9b67747c_c, category=SWSRC
          short-label=ssc_sli_9c030181_c, category=SWSRC
          short-label=ssc_sli_c7dda239_c, category=SWSRC
          short-label=ssc_sli_d064c978_c, category=SWSRC
          short-label=ssc_sli_d80c44d2_c, category=SWSRC
          short-label=ssc_sli_dcd66f69_c, category=SWSRC
          short-label=ssc_sli_e66fe6d5_c, category=SWSRC
          short-label=ssc_sli_e7b327bb_c, category=SWSRC
          short-label=ssc_sli_eb0a5702_c, category=SWSRC
          short-label=ssc_sli_f6bd9cc8_c, category=SWSRC
          short-label=ssc_sli_f9b5dbc5_c, category=SWSRC
          short-label=ssc_sli_fa0ce53e_c, category=SWSRC
          short-label=ssc_sli_fbdf29da_c, category=SWSRC
          short-label=ne_ds_h, category=SWHDR
          short-label=nesl_rtw_h, category=SWHDR
          short-label=external_std_h, category=SWHDR
          short-label=lang_std_h, category=SWHDR
          short-label=mc_std_h, category=SWHDR
          short-label=ne_dae_construct_h, category=SWHDR
          short-label=ne_dae_fwd_h, category=SWHDR
          short-label=ne_ds_h, category=SWHDR
          short-label=ne_profiler_fwd_h, category=SWHDR
          short-label=ne_std_h, category=SWHDR
          short-label=nesl_diag_h, category=SWHDR
          short-label=nesl_la_h, category=SWHDR
          short-label=nesl_rtw_h, category=SWHDR
          short-label=nesl_rtw_utils_h, category=SWHDR
          short-label=nesl_sd_h, category=SWHDR
          short-label=nesl_sd_type_h, category=SWHDR
          short-label=pe_pmsm_drive_project_h, category=SWHDR
          short-label=pe_pmsm_drive_project_5df20146_1_h, category=SWHDR
          short-label=pe_pmsm_drive_project_5df20146_1_ds_h, category=SWHDR
          short-label=pe_pmsm_drive_project_5df20146_1_ds_a_p_h, category=SWHDR
          short-label=pe_pmsm_drive_project_5df20146_1_ds_dnf_p_h, category=SWHDR
          short-label=pe_pmsm_drive_project_5df20146_1_ds_dtf_h, category=SWHDR
          short-label=pe_pmsm_drive_project_5df20146_1_ds_dxf_h, category=SWHDR
          short-label=pe_pmsm_drive_project_5df20146_1_ds_dxf_p_h, category=SWHDR
          short-label=pe_pmsm_drive_project_5df20146_1_ds_dxy_p_h, category=SWHDR
          short-label=pe_pmsm_drive_project_5df20146_1_ds_external_struct_h, category=SWHDR
          short-label=pe_pmsm_drive_project_5df20146_1_ds_externals_h, category=SWHDR
          short-label=pe_pmsm_drive_project_5df20146_1_ds_f_h, category=SWHDR
          short-label=pe_pmsm_drive_project_5df20146_1_ds_log_h, category=SWHDR
          short-label=pe_pmsm_drive_project_5df20146_1_ds_mode_h, category=SWHDR
          short-label=pe_pmsm_drive_project_5df20146_1_ds_obs_act_h, category=SWHDR
          short-label=pe_pmsm_drive_project_5df20146_1_ds_obs_all_h, category=SWHDR
          short-label=pe_pmsm_drive_project_5df20146_1_ds_obs_exp_h, category=SWHDR
          short-label=pe_pmsm_drive_project_5df20146_1_ds_sys_struct_h, category=SWHDR
          short-label=pe_pmsm_drive_project_5df20146_1_ds_tdxf_p_h, category=SWHDR
          short-label=pe_pmsm_drive_project_5df20146_1_ds_tdxy_p_h, category=SWHDR
          short-label=pe_pmsm_drive_project_5df20146_1_ds_zc_h, category=SWHDR
          short-label=pe_pmsm_drive_project_5df20146_1_gateway_h, category=SWHDR
          short-label=pe_pmsm_drive_project_private_h, category=SWHDR
          short-label=pe_pmsm_drive_project_types_h, category=SWHDR
          short-label=pm_default_allocator_h, category=SWHDR
          short-label=pm_inline_h, category=SWHDR
          short-label=pm_printf_h, category=SWHDR
          short-label=pm_printf_precompile_h, category=SWHDR
          short-label=pm_std_h, category=SWHDR
          short-label=pm_types_h, category=SWHDR
          short-label=rt_defines_h, category=SWHDR
          short-label=rt_matrixlib_h, category=SWHDR
          short-label=rtwtypes_h, category=SWHDR
          short-label=ssc_ml_fun_h, category=SWHDR
    resource consumption RsrcCons_pe_pmsm_drive_project
