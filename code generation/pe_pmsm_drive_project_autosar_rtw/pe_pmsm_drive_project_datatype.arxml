AUTOSAR XML (schema 4-3-0)
package /pe_pmsm_drive_project_pkg/pe_pmsm_drive_project_dt/SwAddrMethods
  sw addr method CODE: section-type=CODE
  sw addr method CONST: section-type=CONST
  sw addr method VAR: section-type=VAR
