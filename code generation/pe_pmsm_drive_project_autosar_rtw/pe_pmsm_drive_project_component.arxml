AUTOSAR XML (schema 4-3-0)
package /pe_pmsm_drive_project_pkg/pe_pmsm_drive_project_swc
  application sw component type pe_pmsm_drive_project
    behavior pe_pmsm_drive_project: handle-termination-and-restart=NO-SUPPORT
      timing event Event_Runnable_Step: start-on-event=Runnable_Step, period=2.0E-07
      timing event Event_Runnable_Step1: start-on-event=Runnable_Step1, period=2.0E-06
      runnable Runnable_Init
      runnable Runnable_Step
      runnable Runnable_Step1
